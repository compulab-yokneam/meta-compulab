## conf/layer.conf
```bitbake
# We have a conf and classes directory, append to BBPATH
BBPATH .= ":${LAYERDIR}"

# We have a recipes directory containing .bb and .bbappend files, add to BBFILES
BBFILES += "${LAYERDIR}/recipes*/*/*.bb \
            ${LAYERDIR}/recipes*/*/*.bbappend"

BBFILE_COLLECTIONS += "compulab"
BBFILE_PATTERN_compulab := "^${LAYERDIR}/"
BBFILE_PRIORITY_compulab = "4"

LAYERSERIES_COMPAT_compulab = "rocko sumo thud warrior zeus dunfell gatesgarth hardknott honister kirkstone"

BBMASK += "compulab-qt5-build-env.bb"

INHERIT += "compulab"
ROOTFS_POSTPROCESS_COMMAND += "systemd_resolved_fix; "
```

## conf/machine/cl-som-imx7.conf
```bitbake
#@TYPE: Machine
#@NAME: CompuLab CL-SOM-iMX7
#@SOC: i.MX7D
#@DESCRIPTION: Machine configuration for CompuLab CL-SOM-iMX7 machines
#@MAINTAINER: Ilya Ledvich <ilya@compulab.co.il>

include conf/machine/include/imx-base.inc
include conf/machine/include/tune-cortexa7.inc

SOC_FAMILY = "mx7:mx7d"
MACHINEOVERRIDES =. "mx7:mx7d:"

PREFERRED_PROVIDER_u_boot_cl-som-imx7 = "u-boot-compulab"
PREFERRED_PROVIDER_virtual/bootloader_cl-som-imx7 = "u-boot-compulab"
PREFERRED_PROVIDER_virtual/kernel_cl-som-imx7 = "linux-compulab"

UBOOT_MACHINE ?= "cl_som_imx7_defconfig"

IMAGE_FSTYPES = "sdcard.xz tar.xz"

KERNEL_DEVICETREE = "imx7d-cl-som-imx7.dtb imx7d-sbc-imx7.dtb"

MACHINE_FEATURES += "alsa bluetooth serial usbhost wifi pci"

XSERVER += "mesa-driver-swrast"

MACHINE_FIRMWARE = "linux-firmware-wl18xx"

SERIAL_CONSOLE = "115200 ttymxc0"
```

## conf/machine/cm-fx6.conf
```bitbake
#@TYPE: Machine
#@NAME: CompuLab CM-FX6
#@SOC: i.MX6 Q
#@DESCRIPTION: Machine configuration for CompuLab CM-FX6 machines
#@MAINTAINER: Valentin Raevsky <valentin@compulab.co.il>

require conf/machine/include/imx-base.inc
require conf/machine/include/tune-cortexa9.inc

SOC_FAMILY = "mx6:mx6q"

PREFERRED_PROVIDER_u_boot = "u-boot-compulab"
PREFERRED_PROVIDER_virtual/bootloader = "u-boot-compulab"
PREFERRED_PROVIDER_virtual/kernel_cm-fx6 = "linux-compulab"

UBOOT_MACHINE ?= "cm_fx6_defconfig"

KERNEL_DEVICETREE = "imx6dl-cm-fx6.dtb  imx6dl-sbc-fx6.dtb  imx6dl-sbc-fx6m.dtb  imx6q-cm-fx6.dtb  imx6q-sbc-fx6.dtb  imx6q-sbc-fx6m.dtb"

MACHINE_FEATURES += "pci wifi bluetooth alsa bluetooth serial usbhost wifi"

MACHINE_FIRMWARE_append_mx6 += "linux-firmware-sd8787"

SERIAL_CONSOLE = "115200 ttymxc3"
```
